## Kconfig
```kconfig
config URCHIN_WIDGET
    bool "Enable Urchin Widget"

if URCHIN_WIDGET

config URCHIN_WIDGET_DURATION
    int "Total duration of the animation cycle. < 4800 will be faster > 4800 will be slower"
    default 4800

endif
```

## boards/shields/nice_view_custom_peripheral/Kconfig.shield
```kconfig
# Copyright (c) 2022 The ZMK Contributors
# SPDX-License-Identifier: MIT

config SHIELD_NICE_VIEW_CUSTOM_PERIPHERAL
    def_bool $(shields_list_contains,nice_view_custom_peripheral)
```
